## configs/byondvm_defconfig
```kconfig
BR2_x86_pentium3=y
BR2_KERNEL_HEADERS_5_10=y
BR2_PACKAGE_GLIBC_UTILS=y
BR2_TOOLCHAIN_BUILDROOT_CXX=y
BR2_CCACHE=y
BR2_OPTIMIZE_3=y
BR2_GLOBAL_PATCH_DIR="byondvm/patches"
BR2_PER_PACKAGE_DIRECTORIES=y
BR2_TARGET_GENERIC_HOSTNAME="byondvm"
BR2_TARGET_GENERIC_ISSUE="Welcome to DM Playground"
BR2_ROOTFS_MERGED_USR=y
BR2_TARGET_GENERIC_ROOT_PASSWD="root"
BR2_ENABLE_LOCALE_WHITELIST="C"
BR2_ROOTFS_OVERLAY="byondvm/rootfs_overlay"
BR2_LINUX_KERNEL=y
BR2_LINUX_KERNEL_USE_CUSTOM_CONFIG=y
BR2_LINUX_KERNEL_CUSTOM_CONFIG_FILE="byondvm/byondvm/kernel.config"
BR2_LINUX_KERNEL_LZ4=y
BR2_PACKAGE_BUSYBOX_CONFIG="byondvm/byondvm/busybox.config"
# BR2_PACKAGE_IFUPDOWN_SCRIPTS is not set
# BR2_PACKAGE_URANDOM_SCRIPTS is not set
BR2_PACKAGE_UTIL_LINUX=y
BR2_PACKAGE_UTIL_LINUX_LIBUUID=y
BR2_PACKAGE_NANO=y
# BR2_PACKAGE_NANO_TINY is not set
BR2_TARGET_ROOTFS_CPIO=y
BR2_TARGET_ROOTFS_CPIO_LZ4=y
# BR2_TARGET_ROOTFS_TAR is not set
BR2_PACKAGE_BYONDVM_CONTROLLER=y
```

## package/byondvm-controller/Config.in
```kconfig
config BR2_PACKAGE_BYONDVM_CONTROLLER
	bool "byondvm-controller"
	depends on BR2_PACKAGE_HOST_RUSTC_TARGET_ARCH_SUPPORTS
	select BR2_PACKAGE_HOST_RUSTC
	select BR2_PACKAGE_HOST_PKGCONF
	help
	  Controller package for dm-playground

	  https://githu.com/spacestation13/dm-playground_controller
```
